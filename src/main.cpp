/*******************************************************************************
 * Title                 :   Main
 * Filename              :   main.cpp
 * Author                :   Simone Gasparella
 * Origin Date           :   19/01/2022
 * Compiler              :   xtensa32 2.50200.97
 * Target                :   ESP32WROOMSE
 * Notes                 :   None
 *
 *******************************************************************************/
/****************************************************************************
 * Doxygen C Template
 *
 *
 *****************************************************************************/
/*************** SOURCE REVISION LOG *****************************************
 *
 *    Date    Version   Author         Description
 *  19/01/22   1.0.0   Simone Gasparella   Initial Release.
 *
 *******************************************************************************/
/** @file : main.cpp
 *  @brief This is the main file of the example. Connection with aws iot with ethernet shield ENCj2860 comm with esp32 via SPI
 */

#include <Arduino.h>
#include <SPI.h>
#include <Ethernet.h>
#include "Ethernet_pinout_setting.h"
#include <AsyncTCP.h>
#include <ESPAsyncWebServer.h>
#include <ArduinoOTA.h>

SPIClass ethernetSPI(ETH_SPI_BUS);
EthernetServer server(80);

/**
 * @brief  Function to execute the setup generated by the arduino framework
 * @param  None
 * @retval None
 */
void setup()
{

  Ethernet.init(ETH_CS, &ethernetSPI, ETH_SCLK, ETH_MISO, ETH_MOSI);
  Serial.begin(115200);
  while (!Serial)
  {
    ; // wait for serial port to connect. Needed for native USB port only
  }
  Ethernet.begin(mac);
  // Check for Ethernet hardware present
  if (Ethernet.hardwareStatus() == EthernetNoHardware)
  {
    Serial.println("Ethernet shield was not found.  Sorry, can't run without hardware. :(");
    while (true)
    {
      delay(1); // do nothing, no point running without Ethernet hardware
    }
  }
  if (Ethernet.linkStatus() == LinkOFF)
  {
    Serial.println("Ethernet cable is not connected.");
  }

  Serial.print("Joined LAN with IP ");
  Serial.println(Ethernet.localIP());
  Serial.flush()
      delay(200);
  Serial.println("HTTP server started");

  ArduinoOTA.begin(Ethernet.localIP(), "systel", "lab2022", InternalStorage);
}
/**
 * @brief  Function to execute the loop of the mqtt connection
 * @param  None
 * @retval None
 */
void loop()
{
  ArduinoOTA.poll();
  // constantly maintain DHCP ip in the long run
  Ethernet.maintain();
}